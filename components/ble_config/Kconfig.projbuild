## components/button_irq/Kconfig.projbuild
```kconfig
menu "Button IRQ Configuration"
    config  GPIO_BRIGHTNESS_INC 
        int "GPIO Pin For Brightness Increment Button"
        range 0 30
        default 0

    config  GPIO_BRIGHTNESS_DEC
        int "GPIO Pin For Brightness Decrement Button"
        range 0 30
        default 0

    config  GPIO_WEATHER_INC
        int "GPIO Pin For Brightness Increment Button"
        range 0 30
        default 0

    config  GPIO_WEATHER_DEC
        int "GPIO Pin For Weather Decrement Button"
        range 0 30
        default 0

    config  GPIO_PWM_CONTROL
        int "GPIO Pin For PWM Output"
        range 0 30
        default 0

    endmenu
```

## components/i2c-lcd1602/Kconfig.projbuild
```kconfig
menu "i2c-lcd1602 Configuration"
    config I2C_MASTER_NUM
        int "I2C Master Bus"
        range 0 1
        default 0
    
    config I2C_MASTER_FREQ_HZ
        int "I2C Master frequency in Hertz"
        range 1000 5000000
        default 100000
    
    config I2C_MASTER_TX_BUF_LEN
        int "I2C Master Transmitter Buffer Size"
        range 0 20
        default 0
        
    config I2C_MASTER_RX_BUF_LEN
        int "I2C Master Receiver Buffer Size"
        range 0 20
        default 0

    config I2C_MASTER_SCL_IO
        int "I2C Master SCL GPIO number"
        range 0 34
        default 22
        help
            GPIO number (IOxx) for I2C SCL.
    
            Some GPIOs are used for other purposes (flash connections, etc.) and cannot be used.
    
            GPIOs 35-39 are input-only so cannot be used to drive the One Wire Bus.
    
    config I2C_MASTER_SDA_IO
        int "I2C Master SDA GPIO number"
        range 0 34
        default 21
        help
            GPIO number (IOxx) for I2C SDA.
    
            Some GPIOs are used for other purposes (flash connections, etc.) and cannot be used.
    
            GPIOs 35-39 are input-only so cannot be used to drive the One Wire Bus.
    
    config LCD1602_I2C_ADDRESS
        hex "I2C Address for LCD1602 device"
        default 0x3F
        help
            I2C address for HD44780-compatible LCD1602 device, LCD2004-0x3F, LCD1602-0x27

    config LCD_NUM_ROWS
        int "LCD Display Number of Rows"
        default 4

    config LCD_NUM_COLUMNS
        int "LCD Display Number of Columns"
        default 20

    config LCD_NUM_VISIBLE_COLUMNS
        int "LCD Display number of visible columns"
        default 16

    endmenu
```

## components/weather_sync/Kconfig.projbuild
```kconfig
menu "Open Weather API Configuration"
    config OPENWEATHERMAP_API_KEY
        string "OpenWeatherMap User API key"
        default ""
        help
            OpenWeatherMap User API key. See project READMe.MD for instructions

    config LOCATION_ID
        string "OpenWeatherMap API location code"
        default "NY,US"
        help 
            See https://en.wikipedia.org/wiki/List_of_ISO_3166_country_codes
    endmenu
```

## main/Kconfig.projbuild
```kconfig
menu "Weather Clock Configuration"
    config TIMEZONE
        string "Clock Time Zone"
        default "EST5EDT,M3.2.0,M11.1.0"
        help
            Time Zone of desired region

    config CITY
        string "WiFi Password"
        default "New York"
        help
            The City/Town/Region string specified to use. 
    config NTP_RESYNC_PERIOD
        int "NTP Resync Period"
        default 14400
        help
            Time between NTP remote resynchronization. (Seconds)
    config WEATHER_RESYNC_PERIOD
        int "WEATHER Resync Period"
        default 14400
        help
            Time between Weather remote resynchronization. (Seconds)   
    endmenu
```
